## Kconfig
```kconfig
config CORNIX_CHARGING_INDICATOR
    bool "Cornix USB-powered charging indicator"
    depends on WS2812_WIDGET && USB_DEVICE_STACK && ZMK_BATTERY_REPORTING
    default y
    help
      Blink the half's WS2812 LEDs while USB power is present and the battery
      estimate is below the configured full level. This is a USB-powered
      indicator, not a charger IC status signal.

if CORNIX_CHARGING_INDICATOR

config CORNIX_CHARGING_INDICATOR_FULL_LEVEL
    int "Battery percentage treated as full"
    default 100
    range 1 100

config CORNIX_CHARGING_INDICATOR_COLOR
    hex "Charging indicator color"
    default 0x004000

config CORNIX_CHARGING_INDICATOR_STEP_MS
    int "Charging indicator breath step duration"
    default 35

config CORNIX_CHARGING_INDICATOR_BREATH_STEPS
    int "Charging indicator breath steps"
    default 24
    range 2 255

config CORNIX_CHARGING_INDICATOR_OFF_HOLD_MS
    int "Charging indicator off hold duration"
    default 840

endif # CORNIX_CHARGING_INDICATOR
```

## boards/shields/cornix_dongle/Kconfig.defconfig
```kconfig
if SHIELD_CORNIX_DONGLE

config ZMK_KEYBOARD_NAME
    default "Cornix"

# Dongle = BLE split central with 2 peripherals (left + right halves)
config ZMK_SPLIT
    default y

config ZMK_SPLIT_ROLE_CENTRAL
    default y

config ZMK_SPLIT_BLE_CENTRAL_PERIPHERALS
    default 2

# P0.09 / P0.10 used as GPIO matrix columns (NFC pins repurposed)
config NFCT_PINS_AS_GPIOS
    default y

endif # SHIELD_CORNIX_DONGLE
```

## config/west.yml
```yaml
# ZMK Config for Cornix (XIAO nRF52840 dongle + Prospector + RawHID)
manifest:
  remotes:
    - name: zmkfirmware
      url-base: https://github.com/zmkfirmware
    - name: hrmt-lab
      url-base: https://github.com/hrmt-lab
  projects:
    - name: zmk
      remote: zmkfirmware
      revision: main
      import: app/west.yml
    # Cornix board/shield definitions (cornix_left / cornix_right / cornix_ph_left, indicator)
    - name: zmk-keyboard-cornix
      remote: hrmt-lab
      revision: main
    # Prospector ring status screen (dongle display)
    - name: prospector-zmk-module-ring
      remote: hrmt-lab
      revision: main
    # Raw HID transport + application protocol (time / layer / AI usage)
    - name: zmk-raw-hid
      remote: hrmt-lab
      revision: custom/raw-hid-custom
    - name: zmk-rawhid-app
      remote: hrmt-lab
      revision: main
  self:
    path: config
```
